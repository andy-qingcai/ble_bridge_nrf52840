## CMakeLists.txt
```
# suota_sim - SUOTA peripheral simulator.
#
# Standalone Zephyr peripheral application that emulates a reference SUOTA
# device: 0xFEF5 SUOTA service with all 10 characteristics,
# immediate ATT MTU exchange on connect (via CONFIG_BT_GATT_AUTO_UPDATE_MTU,
# see prj.conf) and the slave-side SUOTA state machine.
#
# Build (gate):
#   west build -p -b nrf52840dk/nrf52840 firmware/suota_sim -d ~/blebridge/ncs/build-suota_sim

cmake_minimum_required(VERSION 3.20.0)

find_package(Zephyr REQUIRED HINTS $ENV{ZEPHYR_BASE})
project(suota_sim LANGUAGES C)

target_sources(app PRIVATE
  src/main.c
  src/suota_svc.c
  src/sim_addr.c
)

# Same warning bar as the bridge app (Zephyr already adds -Wall).
target_compile_options(app PRIVATE -Wall -Wextra)
```

## Kconfig
```
# suota_sim application options (Task 11).

mainmenu "suota_sim - SUOTA peripheral simulator"

menu "suota_sim options"

config SUOTA_SIM_ADV_NAME
	string "advertising local name"
	default "SuotaSim"

config SUOTA_SIM_ADV_INTERVAL_MS
	int "advertising interval in ms (continuous mode)"
	default 100
	range 20 10000
	help
	  Interval of the connectable advertising when
	  SUOTA_SIM_ADV_BURST is disabled.  Default 100 ms.

config SUOTA_SIM_ADV_BURST
	bool "burst advertising (20 s burst pattern)"
	default n
	help
	  When enabled suota_sim does not advertise continuously but in
	  bursts: SUOTA_SIM_ADV_BURST_ON_MS of advertising followed by
	  silence for the remainder of SUOTA_SIM_ADV_BURST_PERIOD_S.

config SUOTA_SIM_ADV_BURST_ON_MS
	int "duration of one advertising burst in ms"
	default 5000
	range 100 60000

config SUOTA_SIM_ADV_BURST_PERIOD_S
	int "period of the advertising burst cycle in s"
	default 20
	range 2 3600

config SUOTA_SIM_ADDR_MODE
	string "address source: \"fixed\" (compile time constant) or \"nvs\" (generate once, persist)"
	default "fixed"

config SUOTA_SIM_ADDR
	string "fixed static random address (valid when ADDR_MODE=\"fixed\")"
	default "C0:FF:EE:12:34:56"
	help
	  Fixed static random address for the simulator.  The two most
	  significant bits of the first octet must be set for a legal
	  static random address (BT Core Vol 6, B 1.3); 0xC0 satisfies that.

config SUOTA_SIM_VERSION
	int "SUOTA_VERSION characteristic value (reference value: 13 = 0x0D)"
	default 13
	range 0 255

config SUOTA_SIM_MAX_CHUNK
	int "PATCH_DATA chunk cap / PATCH_DATA_CHAR_SIZE value (reference value: 244)"
	default 244
	range 20 244

config SUOTA_SIM_ATT_MTU_INFO
	int "ATT MTU reported by the SUOTA MTU info characteristic (reference value: 251)"
	default 251
	range 23 517

config SUOTA_SIM_PSM
	int "L2CAP PSM reported by the L2CAP_PSM characteristic (reference value: 129)"
	default 129
	range 1 65535

config SUOTA_SIM_MEM_INFO
	int "bytes reported by the MEM_INFO characteristic (example value: 4 MB)"
	default 4194304
	range 0 4294967295

config SUOTA_SIM_BLOCK_MAX
	int "upper bound accepted for PATCH_LEN (default protection: 2048)"
	default 2048
	range 20 65535

config SUOTA_SIM_BLOCK_ACK_DELAY_MS
	int "delay before the per-block 0x02 ACK notification (reference device: 120-135 ms; 0 = instant for fast tests)"
	default 130
	range 0 30000

config SUOTA_SIM_REBOOT_DELAY_S
	int "delay between REBOOT disconnect and re-advertising (reference device: ~10 s)"
	default 10
	range 0 300

config SUOTA_SIM_SAME_IMAGE
	bool "reject MEM_DEV banks equal to the running bank with SAME_IMAGE"
	default n
	help
	  When enabled, a MEM_DEV start write whose bank equals
	  SUOTA_SIM_SAME_IMAGE_BANK is refused with SAME_IMAGE (0x15).
	  Behavior note (measured against a reference SUOTA device): the
	  refusal is carried in the ATT write response itself (error code
	  0x15) and no SERV_STATUS notification is sent.  AN-B-022 lists 0x15
	  as a SERV_STATUS notify value; the observed behavior takes
	  precedence here, and the host (host/src/blebridge/suota.py) maps
	  both delivery paths to the same SameImageError.

config SUOTA_SIM_SAME_IMAGE_BANK
	int "bank the simulated device is considered to be running from (0x15 trigger)"
	default 0
	range 0 255

config SUOTA_SIM_EXPECTED_SIZE
	int "expected upload size in bytes, including the trailing XOR checksum byte (0 = do not check)"
	default 0
	range 0 4294967295
	help
	  When non-zero, the END command compares the accumulated byte
	  total against this value; a mismatch is reported with status
	  0x13 (INVALID_IMAGE_SIZE, AN-B-022 section 2.1).
	  Note the SUOTA upload carries fileSize + 1 bytes because the
	  sender appends the whole-file XOR checksum byte.

config SUOTA_SIM_CHECK_XOR
	bool "enforce XOR checksum == 0 at END (reject with 0x04 CRC_MISMATCH)"
	default n
	help
	  The running XOR over the whole upload equals zero when (and only
	  when) the sender appended the correct whole-file XOR byte, so
	  this is a real protocol check even in accounting mode.  Off by
	  default: whether a given SUOTA device enforces it is not
	  guaranteed by AN-B-022.
	  HIL note: strict HIL acceptance
	  requires this option PLUS a matching SUOTA_SIM_EXPECTED_SIZE.
	  Both are wired together in
	  firmware/suota_sim/boards/nrf52840dk_nrf52840_hil.conf, attached by
	  `tools/flash.sh suota_sim --hil` (the default build stays a fast
	  smoke build with both checks off).

config SUOTA_SIM_KEEP_HEADER
	bool "keep the first 4 KiB of the upload in RAM for debugger dump"
	default n

config SUOTA_SIM_ABORT_STATUS
	int "status code notified after ABORT (brief: 2 = 0x02; alt: 3 = 0x03 SRV_EXIT)"
	default 2
	range 1 255

endmenu

source "Kconfig.zephyr"
```

## prj.conf
```kconfig
# suota_sim - SUOTA peripheral simulator - nrf52840dk/nrf52840.

CONFIG_BT=y
CONFIG_BT_PERIPHERAL=y

# ---------------------------------------------------------------------------
# Core behavior under test (FR-E2): the simulator sends ATT_EXCHANGE_MTU_REQ
# immediately after the connection is established, before doing anything
# else (peripheral-initiated MTU exchange, AN-B-022 reference behavior).
#
# CONFIG_BT_GATT_CLIENT is a *compile-time* gate for bt_gatt_exchange_mtu()
# and the MTU_RSP handler - it does NOT change our role.
# CONFIG_BT_GATT_AUTO_UPDATE_MTU makes the stack send the MTU request by
# itself the instant the ATT bearer comes up (before the application
# connected callback), which is exactly the behavior under test, with zero
# application code.  Verified against NCS v3.4.1 / Zephyr 4.4.2.
# ---------------------------------------------------------------------------
CONFIG_BT_GATT_CLIENT=y            # compile gate for the MTU-REQ path (quirk switch)
CONFIG_BT_GATT_AUTO_UPDATE_MTU=y   # connect => automatic MTU_REQ (quirk switch)

# The request value is MIN(BT_L2CAP_TX_MTU, BT_BUF_ACL_RX_SIZE - 4).
# 251/255 => the suota_sim requests ATT MTU 251, matching the reference
# device (SUOTA MTU characteristic = 251) and accepts
# 244-byte PATCH_DATA writes.  Defaults (23/27) would cap us at MTU 23.
CONFIG_BT_L2CAP_TX_MTU=251
CONFIG_BT_BUF_ACL_RX_SIZE=255
# 244 B fits in one packet; no long writes.
CONFIG_BT_ATT_PREPARE_COUNT=0

# Sane headroom for the per-block 0x02 notifications.
CONFIG_BT_CONN_TX_MAX=10

# No pairing/bonding: SUOTA runs in the clear (AN-B-022),
# all characteristics use plain (non-encryption-required) permissions.

# Observability: every state transition / validation error goes to Zephyr LOG
# (RTT or UART console per board defaults - this app has no protocol stream
# that could be polluted).
CONFIG_LOG=y

# Runtime image accounting only (no real flash storage of the image).
# The 4 KiB header buffer (SUOTA_SIM_KEEP_HEADER) is plain RAM.

# Address persistence for SUOTA_SIM_ADDR_MODE="nvs" (storage_partition on
# the nrf52840dk devicetree).  Compiled in unconditionally so the NVS path
# stays compile-checked by the build gate even in the default "fixed" mode.
CONFIG_FLASH=y
CONFIG_FLASH_MAP=y
CONFIG_NVS=y

# Skeleton hygiene, same bar as the bridge app.
CONFIG_ASSERT=y
CONFIG_THREAD_NAME=y
CONFIG_BUILD_OUTPUT_HEX=y

# bt_enable() + address setup run on the main thread; notifies run on the
# system workqueue.
CONFIG_MAIN_STACK_SIZE=2048
CONFIG_SYSTEM_WORKQUEUE_STACK_SIZE=2048
```

## boards/nrf52840dk_nrf52840_hil.conf
```kconfig
# suota_sim HIL 严格校验形态（task(12) 终审 I-2）。
#
# 本文件不会被 Zephyr 自动合入（自动合入只认 boards/<board>.conf 精确名）；
# 仅当 `tools/flash.sh suota_sim --hil` 以
#   -DEXTRA_CONF_FILE=boards/nrf52840dk_nrf52840_hil.conf
# 附加时生效。默认（快速冒烟）构建保持两个校验都关。
#
# HIL 严格验收 = END 时同时校验:
#   - 累计字节数 == EXPECTED_SIZE（不符 -> 0x13 INVALID_IMAGE_SIZE）
#   - 全程 running XOR == 0（不符 -> 0x04 CRC_MISMATCH）

CONFIG_SUOTA_SIM_CHECK_XOR=y

# tools/hil_test.py full(G2) 默认合成镜像 640KiB = 655360 B；
# SUOTA 上传体 = 镜像 + 1B 全文件 XOR 校验字节 = 655361 B。
# 改 hil_test.py --image-bytes（或 --image）时必须同步改这里。
CONFIG_SUOTA_SIM_EXPECTED_SIZE=655361
```

## src/main.c
```c
/*
 * main.c - suota_sim, SUOTA peripheral simulator.
 *
 * Boot: address selection (fixed / NVS) -> bt_enable() -> identity ->
 * advertising.  Advertising payload mirrors the brief contract:
 *   - 16-bit service UUID 0xFEF5 (AD type 0x03, on-air F5 FE) AND the same
 *     UUID inside a manufacturer-specific segment (company id 0xFFFF),
 *   - complete local name "SuotaSim".
 *
 * Advertising schedule (Kconfig):
 *   - default: continuous connectable advertising at
 *     CONFIG_SUOTA_SIM_ADV_INTERVAL_MS (100 ms).
 *   - CONFIG_SUOTA_SIM_ADV_BURST=y: burst pattern - advertise
 *     SUOTA_SIM_ADV_BURST_ON_MS, silent for the remainder of
 *     SUOTA_SIM_ADV_BURST_PERIOD_S, repeat.
 *
 * After a REBOOT command the SUOTA service module reports the restart delay
 * (~10 s restart delay, reference-device behavior) and advertising resumes then.
 *
 * The MTU quirk itself needs no code here: CONFIG_BT_GATT_AUTO_UPDATE_MTU
 * makes the stack fire ATT_EXCHANGE_MTU_REQ during connection setup (see
 * prj.conf); we only observe it via the att_mtu_updated callback.
 */

#include <zephyr/kernel.h>
#include <zephyr/logging/log.h>
#include <zephyr/sys/util.h>
#include <zephyr/bluetooth/bluetooth.h>
#include <zephyr/bluetooth/conn.h>
#include <zephyr/bluetooth/gatt.h>
#include <zephyr/bluetooth/uuid.h>

#include <string.h>

#include "sim_addr.h"
#include "suota_svc.h"

LOG_MODULE_REGISTER(suota_sim);

/* 100 ms => 160 units (BLE time = N * 0.625 ms), legal ADV_IND range. */
#define ADV_UNITS(ms) ((uint16_t)((((uint32_t)(ms)) * 1000U) / 625U))

BUILD_ASSERT(ADV_UNITS(CONFIG_SUOTA_SIM_ADV_INTERVAL_MS) >= 0x0020 &&
	     ADV_UNITS(CONFIG_SUOTA_SIM_ADV_INTERVAL_MS) <= 0x3FFF,
	     "SUOTA_SIM_ADV_INTERVAL_MS outside the legal advertising range");
BUILD_ASSERT((CONFIG_SUOTA_SIM_ADV_BURST_PERIOD_S * 1000) >
	     CONFIG_SUOTA_SIM_ADV_BURST_ON_MS,
	     "advertising burst must be shorter than its period");
BUILD_ASSERT(sizeof(CONFIG_SUOTA_SIM_ADV_NAME) <= 29,
	     "SUOTA_SIM_ADV_NAME too long for one advertising packet");

#define SUOTA_ADV_UUID16 0xfef5u
#define MSD_COMPANY_TEST 0xffffu /* Bluetooth test company id */

static uint8_t ad_flags = BT_LE_AD_GENERAL | BT_LE_AD_NO_BREDR;
static uint8_t ad_uuid16[2] = { BT_UUID_16_ENCODE(SUOTA_ADV_UUID16) };       /* F5 FE */
static uint8_t ad_msd[4] = { 0xFF, 0xFF, BT_UUID_16_ENCODE(SUOTA_ADV_UUID16) }; /* 0xFFFF + F5 FE */
static char adv_name[sizeof(CONFIG_SUOTA_SIM_ADV_NAME)];

static struct bt_data adv_data[] = {
	BT_DATA(BT_DATA_FLAGS, &ad_flags, sizeof(ad_flags)),
	BT_DATA(BT_DATA_UUID16_ALL, ad_uuid16, sizeof(ad_uuid16)),
	BT_DATA(BT_DATA_MANUFACTURER_DATA, ad_msd, sizeof(ad_msd)),
	BT_DATA(BT_DATA_NAME_COMPLETE, adv_name, sizeof(adv_name) - 1),
};

static const struct bt_le_adv_param adv_param = {
	.id = 0,
	.sid = 0,
	.options = BT_LE_ADV_OPT_CONN,
	.interval_min = ADV_UNITS(CONFIG_SUOTA_SIM_ADV_INTERVAL_MS),
	.interval_max = ADV_UNITS(CONFIG_SUOTA_SIM_ADV_INTERVAL_MS),
};

static bool adv_active;
static bool conn_active;

static struct k_work_delayable burst_work;
static struct k_work_delayable adv_restart_work;

static void adv_start(void)
{
	int err;

	if (conn_active) {
		return;
	}

	err = bt_le_adv_start(&adv_param, adv_data, ARRAY_SIZE(adv_data), NULL, 0);
	if (err) {
		LOG_ERR("advertising failed: %d", err);
		return;
	}
	adv_active = true;
	LOG_INF("advertising: \"%s\" 0xFEF5 @ %d ms%s",
		adv_name, CONFIG_SUOTA_SIM_ADV_INTERVAL_MS,
		IS_ENABLED(CONFIG_SUOTA_SIM_ADV_BURST) ? " (burst mode)" : "");

	if (IS_ENABLED(CONFIG_SUOTA_SIM_ADV_BURST)) {
		k_work_schedule(&burst_work,
				K_MSEC(CONFIG_SUOTA_SIM_ADV_BURST_ON_MS));
	}
}

static void burst_work_handler(struct k_work *work)
{
	ARG_UNUSED(work);
	int err;

	if (adv_active) {
		err = bt_le_adv_stop();
		if (err) {
			LOG_ERR("burst stop failed: %d", err);
		}
		adv_active = false;
		LOG_INF("burst end, silent for %d s",
			CONFIG_SUOTA_SIM_ADV_BURST_PERIOD_S * 1000 -
			CONFIG_SUOTA_SIM_ADV_BURST_ON_MS);
		k_work_schedule(&burst_work,
				K_MSEC(CONFIG_SUOTA_SIM_ADV_BURST_PERIOD_S * 1000 -
				       CONFIG_SUOTA_SIM_ADV_BURST_ON_MS));
	} else {
		adv_start();
	}
}

static void adv_restart_work_handler(struct k_work *work)
{
	ARG_UNUSED(work);
	LOG_INF("restart delay elapsed, re-advertising (REBOOT emulation)");
	adv_start();
}

/* Observability for the G1 gate: logs the negotiated ATT MTU the moment it
 * settles - i.e. the peripheral-initiated MTU exchange answered. */
static void mtu_updated(struct bt_conn *conn, uint16_t tx, uint16_t rx)
{
	ARG_UNUSED(conn);
	LOG_INF("ATT MTU updated: tx=%u rx=%u (peer MTU_REQ answered)", tx, rx);
}

static struct bt_gatt_cb gatt_cbs = {
	.att_mtu_updated = mtu_updated,
};

static void connected(struct bt_conn *conn, uint8_t err)
{
	char addr_str[BT_ADDR_LE_STR_LEN];

	bt_addr_le_to_str(bt_conn_get_dst(conn), addr_str, sizeof(addr_str));

	if (err) {
		LOG_ERR("connection failed (%u) from %s", err, addr_str);
		return;
	}

	conn_active = true;
	adv_active = false; /* connectable adv is torn down by the stack */
	k_work_cancel_delayable(&burst_work);
	k_work_cancel_delayable(&adv_restart_work);

	LOG_INF("connected: %s", addr_str);
	suota_connected(conn);
}

static void disconnected(struct bt_conn *conn, uint8_t reason)
{
	char addr_str[BT_ADDR_LE_STR_LEN];
	uint32_t delay_ms;

	bt_addr_le_to_str(bt_conn_get_dst(conn), addr_str, sizeof(addr_str));
	LOG_INF("disconnected (reason 0x%02x): %s", reason, addr_str);

	conn_active = false;

	delay_ms = suota_disconnected(conn);
	if (delay_ms == 0) {
		adv_start();
	} else {
		/* REBOOT emulation: stay quiet for the configured delay. */
		k_work_schedule(&adv_restart_work, K_MSEC(delay_ms));
	}
}

BT_CONN_CB_DEFINE(conn_cbs) = {
	.connected = connected,
	.disconnected = disconnected,
};

int main(void)
{
	bt_addr_le_t addr;
	bool have_addr;
	int err;

	suota_init();

	have_addr = sim_addr_get(&addr) == 0;

	err = bt_enable(NULL);
	if (err) {
		LOG_ERR("bt_enable failed: %d", err);
		return err;
	}
	LOG_INF("Bluetooth ready");

	err = bt_set_name(CONFIG_SUOTA_SIM_ADV_NAME);
	if (err) {
		LOG_WRN("bt_set_name failed: %d", err);
	}
	strcpy(adv_name, CONFIG_SUOTA_SIM_ADV_NAME);

	if (have_addr) {
		char addr_str[BT_ADDR_LE_STR_LEN];

		err = bt_id_create(&addr, NULL);
		if (err < 0) {
			LOG_ERR("bt_id_create(fixed) failed: %d, falling back", err);
		}
		bt_addr_le_to_str(&addr, addr_str, sizeof(addr_str));
		LOG_INF("identity address: %s", addr_str);
	}
	if (!have_addr || err < 0) {
		/* Stack-generated random static address (changes per boot). */
		err = bt_id_create(NULL, NULL);
		if (err < 0) {
			LOG_ERR("bt_id_create failed: %d", err);
			return err;
		}
	}

	bt_gatt_cb_register(&gatt_cbs);

	k_work_init_delayable(&burst_work, burst_work_handler);
	k_work_init_delayable(&adv_restart_work, adv_restart_work_handler);

	adv_start();

	for (;;) {
		k_sleep(K_FOREVER);
	}
	return 0;
}
```

## src/sim_addr.c
```c
/*
 * sim_addr.c - suota_sim device address selection (Task 11).
 *
 * "fixed": compile-time constant static random address (default;
 *          the address must have the two most significant bits of its
 *          first octet set to be a legal static random address).
 * "nvs":   static random address generated once with bt_addr_le_create_static()
 *          and persisted in NVS on the board's storage_partition, so the
 *          address survives reboots (bonding-friendly mode).
 */

#include <zephyr/kernel.h>
#include <zephyr/logging/log.h>
#include <zephyr/kvss/nvs.h>
#include <zephyr/storage/flash_map.h>
#include <zephyr/bluetooth/addr.h>

#include <errno.h>
#include <string.h>

#include "sim_addr.h"

LOG_MODULE_DECLARE(suota_sim);

#define SIM_ADDR_NVS_ID 1

/* nRF52840 flash page / erase unit. */
#define SIM_ADDR_SECTOR_SIZE 4096u

static bool addr_is_static_random(const bt_addr_le_t *a)
{
	/* Static random device address: the two most significant bits of the
	 * most significant octet are 1 (BT Core 5.3 Vol 6 B 1.3). */
	return (a->a.val[5] & 0xC0u) == 0xC0u;
}

static int addr_fixed(bt_addr_le_t *out)
{
	int rc = bt_addr_from_str(CONFIG_SUOTA_SIM_ADDR, &out->a);

	if (rc) {
		LOG_ERR("SUOTA_SIM_ADDR \"%s\" is not a valid address",
			CONFIG_SUOTA_SIM_ADDR);
		return -EINVAL;
	}
	out->type = BT_ADDR_LE_RANDOM;

	if (!addr_is_static_random(out)) {
		LOG_ERR("SUOTA_SIM_ADDR is not a static random address "
			"(top two bits of %02x must be 1)", out->a.val[5]);
		return -EINVAL;
	}
	return 0;
}

static int addr_nvs(bt_addr_le_t *out)
{
	static struct nvs_fs fs;
	const struct flash_area *fa;
	ssize_t rc;

	rc = flash_area_open(PARTITION_ID(storage_partition), &fa);
	if (rc) {
		LOG_ERR("storage_partition open failed: %d", (int)rc);
		return (int)rc;
	}

	fs.flash_device = flash_area_get_device(fa);
	fs.offset = fa->fa_off;
	fs.sector_size = SIM_ADDR_SECTOR_SIZE;
	fs.sector_count = fa->fa_size / fs.sector_size;

	rc = nvs_mount(&fs);
	if (rc) {
		LOG_ERR("nvs_mount failed: %d", (int)rc);
		flash_area_close(fa);
		return (int)rc;
	}

	rc = nvs_read(&fs, SIM_ADDR_NVS_ID, &out->a, sizeof(out->a));
	if (rc == sizeof(out->a) && addr_is_static_random(out)) {
		out->type = BT_ADDR_LE_RANDOM;
		LOG_INF("address restored from NVS: %02x:%02x:%02x:%02x:%02x:%02x",
			out->a.val[5], out->a.val[4], out->a.val[3],
			out->a.val[2], out->a.val[1], out->a.val[0]);
		flash_area_close(fa);
		return 0;
	}

	rc = bt_addr_le_create_static(out);
	if (rc) {
		LOG_ERR("bt_addr_le_create_static failed: %d", (int)rc);
		flash_area_close(fa);
		return (int)rc;
	}

	rc = nvs_write(&fs, SIM_ADDR_NVS_ID, &out->a, sizeof(out->a));
	if (rc != sizeof(out->a)) {
		LOG_ERR("NVS address persist failed: %d (using it anyway for this boot)",
			(int)rc);
	} else {
		LOG_INF("new static random address generated and persisted");
	}
	out->type = BT_ADDR_LE_RANDOM;
	flash_area_close(fa);
	return 0;
}

int sim_addr_get(bt_addr_le_t *out)
{
	if (strcmp(CONFIG_SUOTA_SIM_ADDR_MODE, "fixed") == 0) {
		return addr_fixed(out);
	}
	if (strcmp(CONFIG_SUOTA_SIM_ADDR_MODE, "nvs") == 0) {
		return addr_nvs(out);
	}
	LOG_ERR("SUOTA_SIM_ADDR_MODE must be \"fixed\" or \"nvs\", got \"%s\"",
		CONFIG_SUOTA_SIM_ADDR_MODE);
	return -EINVAL;
}
```

## src/sim_addr.h
```c
/*
 * sim_addr.h - suota_sim device address selection (Task 11).
 *
 * SUOTA_SIM_ADDR_MODE = "fixed": compile-time constant static random
 *   address (CONFIG_SUOTA_SIM_ADDR), deterministic across reboots.
 * SUOTA_SIM_ADDR_MODE = "nvs": static random address generated once and
 *   persisted in NVS on the board's storage_partition.
 */

#ifndef SUOTA_SIM_SIM_ADDR_H_
#define SUOTA_SIM_SIM_ADDR_H_

#include <zephyr/bluetooth/addr.h>

/* Returns 0 and fills *out (BT_ADDR_LE_RANDOM) on success, -errno otherwise. */
int sim_addr_get(bt_addr_le_t *out);

#endif /* SUOTA_SIM_SIM_ADDR_H_ */
```

## src/suota_svc.h
```c
/*
 * suota_svc.h - SUOTA (0xFEF5) slave emulation for suota_sim (Task 11).
 *
 * Contract with main.c:
 *   - suota_init()          once at boot (self-tests, work items).
 *   - suota_connected()     from the application connected callback.
 *   - suota_disconnected()  from the application disconnected callback;
 *                           returns how long (ms) advertising should wait
 *                           before restarting (REBOOT emulation), 0 = now.
 */

#ifndef SUOTA_SIM_SUOTA_SVC_H_
#define SUOTA_SIM_SUOTA_SVC_H_

#include <stdint.h>

struct bt_conn;

void suota_init(void);
void suota_connected(struct bt_conn *conn);
uint32_t suota_disconnected(struct bt_conn *conn);

#endif /* SUOTA_SIM_SUOTA_SVC_H_ */
```
